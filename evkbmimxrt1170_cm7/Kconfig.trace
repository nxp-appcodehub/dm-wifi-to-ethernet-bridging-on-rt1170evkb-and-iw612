## evkbmimxrt1170_cm7/Kconfig.trace
```kconfig
config CUSTOM_APP_WIFI_CLI
    bool
    default y
    select MCUX_PRJSEG_config.arm.warn_as_error
    select MCUX_PRJSEG_config.arm.shared
    select MCUX_PRJSEG_config.rt.shared
    select MCUX_PRJSEG_config.device_core.define
    select MCUX_PRJSEG_config.arm.core.cm7f
    select MCUX_PRJSEG_config.arm.core.fpu.fpv5_dp
    select MCUX_COMPONENT_CMSIS_Include_core_cm
    select MCUX_PRJSEG_module.device.suite
    select MCUX_COMPONENT_component.silicon_id_imxrt1170
    select MCUX_COMPONENT_middleware.lwip.apps.lwiperf.non_generated_lwipopts
    select MCUX_COMPONENT_middleware.sdmmc.common
    select MCUX_COMPONENT_middleware.sdmmc.osa
    select MCUX_COMPONENT_middleware.sdmmc.usdhc.template
```
